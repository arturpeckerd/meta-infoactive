## conf/layer.conf
```bitbake
# We have a conf and classes directory, add to BBPATH
BBPATH .= ":${LAYERDIR}"

# We have recipes-* directories, add to BBFILES
BBFILES += "${LAYERDIR}/recipes-*/*/*.bb \
	${LAYERDIR}/recipes-*/*/*.bbappend"

BBFILE_COLLECTIONS += "infoactive"
BBFILE_PATTERN_infoactive = "^${LAYERDIR}/"
BBFILE_PRIORITY_infoactive = "6"

DISTRO_FEATURES_remove += "x11 wayland directfb"
```
